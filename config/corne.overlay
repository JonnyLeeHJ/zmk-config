/ {
    chosen {
        zmk,display = &oled;
    };
};

&oled {
    status {
        compatible = "zmk,display-status";
        label = "BONGO CAT";
    };
};

&sl {
    label = "SL";
};

&sr {
    label = "SR";
}; 